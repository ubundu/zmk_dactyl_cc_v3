// dactyl_cc_left.overlay

#include "dactyl_cc.dtsi"

// TODO: Put the correct column GPIOs here.
&kscan0 {
    col-gpios
        = <&gpio1 6  GPIO_ACTIVE_HIGH>  // 38 on the silkscreen
        , <&gpio1 4  GPIO_ACTIVE_HIGH>  // 36 on the silkscreen
        , <&gpio0 11 GPIO_ACTIVE_HIGH>  // GOOD
        , <&gpio1 0  GPIO_ACTIVE_HIGH>  // 32 on silkscreen
        , <&gpio0 24 GPIO_ACTIVE_HIGH>  // GOOD
        , <&gpio0 22 GPIO_ACTIVE_HIGH>  // GOOD
        ;
};
